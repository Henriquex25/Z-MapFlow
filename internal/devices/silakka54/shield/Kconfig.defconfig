## internal/devices/silakka54/shield/Kconfig.defconfig
```kconfig
# SPDX-License-Identifier: MIT
if SHIELD_SILAKKA54_WIRED_LEFT || SHIELD_SILAKKA54_WIRED_RIGHT

config ZMK_KEYBOARD_NAME
    default "Silakka54"

config ZMK_SPLIT
    default y

if SHIELD_SILAKKA54_WIRED_LEFT
config ZMK_SPLIT_ROLE_CENTRAL
    default y
endif

endif
```

## internal/devices/silakka54/shield/Kconfig.shield
```kconfig
# SPDX-License-Identifier: MIT
config SHIELD_SILAKKA54_WIRED_LEFT
    def_bool $(shields_list_contains,silakka54_wired_left)

config SHIELD_SILAKKA54_WIRED_RIGHT
    def_bool $(shields_list_contains,silakka54_wired_right)
```

## internal/devices/soflev2/dongle/Kconfig.defconfig
```kconfig
# SPDX-License-Identifier: MIT
if SHIELD_SOFLE_DONGLE
config ZMK_KEYBOARD_NAME
    default "Sofle Dongle"
config ZMK_SPLIT
    default y
config ZMK_SPLIT_ROLE_CENTRAL
    default y
config ZMK_SPLIT_BLE_CENTRAL_PERIPHERALS
    default 2
endif
```

## internal/zmkmodules/statussync/testdata/display/Kconfig
```kconfig
# SPDX-License-Identifier: MIT
mainmenu "Synchronized display smoke test"
config ZMK_SPLIT
    bool
    default y
config ZMK_BLE
    bool
    default y
config ZMK_SPLIT_ROLE_CENTRAL
    bool
    default n
config ZMK_DISPLAY
    bool
    default y
config ZMK_BATTERY_REPORTING
    bool
    default y
rsource "../../module/Kconfig"
source "Kconfig.zephyr"
```
